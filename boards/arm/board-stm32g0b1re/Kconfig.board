## boards/arm/board-stm32g0b1re/Kconfig.board
```kconfig
# STM32 Nucleo-64 development board with STM32G0B1RE MCU configuration

# Copyright (c) 2019 Thomas Stranger
# SPDX-License-Identifier: Apache-2.0

config KEITHLEY615_COMM_STM32G0B1RE
	bool "Keithley 615 communication board, STM32G0B1RE-based"
	depends on SOC_STM32G0B1XX
```

## boards/arm/board-stm32g0b1re/Kconfig.defconfig
```kconfig
# STM32 Nucleo-64 development board with STM32G0B1RE MCU

# Copyright (c) 2020 Thomas Stranger
# SPDX-License-Identifier: Apache-2.0

if KEITHLEY615_COMM_STM32G0B1RE

config BOARD
	default "board-stm32g0b1re"

endif # BOARD_NUCLEO_G0B1RE
```

## boards/arm/board-stm32g0b1re/board-stm32g0b1re_defconfig
```kconfig
# Zephyr Kernel Configuration
CONFIG_SOC_SERIES_STM32G0X=y
CONFIG_SOC_STM32G0B1XX=y

# Enable MPU
CONFIG_ARM_MPU=y

# Serial Drivers
CONFIG_SERIAL=y
CONFIG_UART_INTERRUPT_DRIVEN=y
# enable console
CONFIG_CONSOLE=y
CONFIG_UART_CONSOLE=y

# GPIO Controller
CONFIG_GPIO=y

# Enable Clocks
CONFIG_CLOCK_CONTROL=y

# enable pin controller
CONFIG_PINCTRL=y

# SPI controller
CONFIG_SPI=y

# Networking
CONFIG_NET_L2_ETHERNET=y
CONFIG_ETH_W5500=y
CONFIG_ETH_W5500_TIMEOUT=1000
CONFIG_NET_DHCPV4=y
CONFIG_NET_MGMT=y

# RNG, needed for DHCP
CONFIG_ENTROPY_STM32_RNG=y

CONFIG_USB_DC_HAS_HS_SUPPORT=y
```
